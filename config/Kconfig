## config/boards/shields/my48/Kconfig.shield
```kconfig
config SHIELD_MY48
    bool "My 48 keyboard shield"
    depends on ARDUINO_PRO_MICRO
    select HAS_NICE_VIEW_DISPLAY if NICE_VIEW
    help
      Enable support for My 48 keyboard shield.
```

## config/dts/bindings/zmk,key-position.yaml
```yaml
# Copyright (c) 2020 The ZMK Contributors
# SPDX-License-Identifier: MIT

description: Key position for ZMK physical layout

compatible: "zmk,key-position"

properties:
  x:
    type: int
    required: true
  y:
    type: int
    required: true
  width:
    type: int
    default: 1
  height:
    type: int
    default: 1
  "#key-cells":
    type: int
    const: 4
```
